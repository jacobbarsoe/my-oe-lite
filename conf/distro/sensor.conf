## conf/distro/sensor.conf
```bitbake
MACHINE_OS = "linux-gnu"
GCC_VERSION = "4.8.2"

DISTRO_USE_sysvinit ?= "1"
DISTRO_USE_mdev ?= "1"
DISTRO_USE_busybox_mdev ?= "1"

# Require login on the console
DISTRO_USE_busybox_inittab_login = "::askfirst:-/bin/login"

# Switch to ZIP format in order to reduce the required memory foot-print on target during updates
DISTRO_USE_dupdate_archiveformat = "zip"
DISTRO_USE_dupdate_args = "$DIR -x $EXEFILE -z $EXEFILE -l"

#busybox
DISTRO_USE_busybox_adduser = "1"
DISTRO_USE_busybox_su = "1"
DISTRO_USE_busybox_losetup = "1"
DISTRO_USE_busybox_feature_mount_loop = "1"
DISTRO_USE_busybox_uniq = "1"
DISTRO_USE_busybox_sort = "1"
DISTRO_USE_busybox_ntpd = "1"
DISTRO_USE_busybox_ntpd_configuration = "-q -p ptbtime1.ptb.de"
DISTRO_USE_busybox_base64 = "1"

DISTRO_USE_linux_srcrev   = "commit=8812404b672364ee794411ed19080dc9b6287682"

#for oe-lite to use kernels >= 3.14
DISTRO_USE_kernel_trace = "1"
DISTRO_USE_fstab = "1"
```

## conf/local.conf
```bitbake
DISTRO?="webserver"

#MACHINE_CPU	 = "i586-c3"
#MACHINE_OS	 = "linux-gnu"

MACHINE ?= "viac3"
#MACHINE = "rpi-server"

SDK_CPU		 = "i686"
SDK_OS		 = "linux-gnu"

PROVIDED	 = "all"

# Uncomment this to keep workdir intact after successful build
RMWORK		 = "0"

PARALLEL_MAKE="-j 5"

MIRRORS = """
http://www.mpfr.org/mpfr-current/ http://ftp.gnu.org/gnu/mpfr/
"""
```

## conf/machine/rpi-common.inc
```bitbake
MACHINE_CPU	= "arm-1176jzfs"
MACHINE_ABI	= "hard"
FW_SRCREV = "commit=3ab17ac25e92ade48325472994b6660c5efd05b5"
FW_DATE   = "20130821"

MACHINE_USE_kernel_defconfig = "bcmrpi_defconfig"
MACHINE_USE_kernel_imagetype = "zImage"

MACHINE_USE_fwupdate_sda="SDA=mmcblk0p"
MACHINE_USE_fwupdate_bootcmd2="BOOTCMD2=\"sed -i s/mmcblk0p2/mmcblk0p3/ /tmp/g/cmdline.txt\""
MACHINE_USE_fwupdate_bootcmd3="BOOTCMD3=\"sed -i s/mmcblk0p3/mmcblk0p2/ /tmp/g/cmdline.txt\""
```
